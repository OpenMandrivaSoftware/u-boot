## configs/pinephone_defconfig
```kconfig
CONFIG_ARM=y
CONFIG_ARCH_SUNXI=y
CONFIG_SPL=y
CONFIG_MACH_SUN50I=y
CONFIG_SUNXI_DRAM_LPDDR3_STOCK=y
CONFIG_DRAM_CLK=552
CONFIG_DRAM_ZQ=3881949
CONFIG_NR_DRAM_BANKS=1
CONFIG_MMC_SUNXI_SLOT_EXTRA=2
CONFIG_R_I2C_ENABLE=y
# CONFIG_SYS_MALLOC_CLEAR_ON_INIT is not set
# CONFIG_SPL_SPI_SUNXI is not set
# CONFIG_SPL_DOS_PARTITION is not set
# CONFIG_SPL_EFI_PARTITION is not set
CONFIG_DEFAULT_DEVICE_TREE="sun50i-a64-pinephone-1.1"
CONFIG_OF_LIST="sun50i-a64-pinephone-1.1 sun50i-a64-pinephone-1.0"
CONFIG_SYS_RELOC_GD_ENV_ADDR=y
CONFIG_DM_REGULATOR=y
CONFIG_DM_REGULATOR_FIXED=y
CONFIG_DM_PWM=y
CONFIG_PWM_SUNXI=y
CONFIG_CMD_GPIO=y
CONFIG_CMD_GPT=y
CONFIG_CMD_I2C=y
CONFIG_CMD_MMC=y
# CONFIG_CMD_MII is not set
# CONFIG_CMD_NFS is not set
# CONFIG_DM_ETH is not set
# CONFIG_PHY is not set
# CONFIG_PHY_GIGE is not set
# CONFIG_SUN8I_EMAC is not set
# CONFIG_PHY_REALTEK is not set
# CONFIG_CMD_SF is not set
# CONFIG_SPI is not set
# CONFIG_DM_SPI is not set
# CONFIG_SPI_FLASH is not set
# CONFIG_SPI_MEM is not set
# CONFIG_DM_SPI_FLASH is not set
```
